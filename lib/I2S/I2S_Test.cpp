#include "mbed.h"

I2S_HandleTypeDef hi2s2;

// a full cycle, 16-bit, 2's complement sine wave lookup table
uint16_t SINE_TABLE[256] = {

   0x0000, 0x0324, 0x0647, 0x096a, 0x0c8b, 0x0fab, 0x12c8, 0x15e2, 
   0x18f8, 0x1c0b, 0x1f19, 0x2223, 0x2528, 0x2826, 0x2b1f, 0x2e11,
   0x30fb, 0x33de, 0x36ba, 0x398c, 0x3c56, 0x3f17, 0x41ce, 0x447a, 
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   0xe708, 0xea1e, 0xed38, 0xf055, 0xf375, 0xf696, 0xf9b9, 0xfcdc,
};


int testSound() {
    printf("Start\n");

    // enable clocks to PORTB, PORTC and SPI2
    __GPIOA_CLK_ENABLE();
	__GPIOB_CLK_ENABLE();
	__GPIOC_CLK_ENABLE();
	__SPI3_CLK_ENABLE();
	
	/**I2S2 GPIO Configuration    
	PB_2     ------> I2S2_SD
	PC_10     ------> I2S2_CK
	PA_4     ------> I2S2_WS 
	*/
	
	GPIO_InitTypeDef GPIO_InitStruct;
	
	GPIO_InitStruct.Pin = GPIO_PIN_4;
	GPIO_InitStruct.Mode = GPIO_MODE_AF_PP;
	GPIO_InitStruct.Pull = GPIO_NOPULL;
	GPIO_InitStruct.Speed = GPIO_SPEED_LOW;
	GPIO_InitStruct.Alternate = GPIO_AF5_SPI3;
	HAL_GPIO_Init(GPIOA, &GPIO_InitStruct);

	GPIO_InitStruct.Pin = GPIO_PIN_2;
	GPIO_InitStruct.Mode = GPIO_MODE_AF_PP;
	GPIO_InitStruct.Pull = GPIO_NOPULL;
	GPIO_InitStruct.Speed = GPIO_SPEED_LOW;
	GPIO_InitStruct.Alternate = GPIO_AF5_SPI3;
	HAL_GPIO_Init(GPIOB, &GPIO_InitStruct);

    GPIO_InitStruct.Pin = GPIO_PIN_10;
	GPIO_InitStruct.Mode = GPIO_MODE_AF_PP;
	GPIO_InitStruct.Pull = GPIO_NOPULL;
	GPIO_InitStruct.Speed = GPIO_SPEED_LOW;
	GPIO_InitStruct.Alternate = GPIO_AF5_SPI3;
	HAL_GPIO_Init(GPIOC, &GPIO_InitStruct);
	
	// intialize I2S clocks
	
	RCC_PeriphCLKInitTypeDef PeriphClkInitStruct;
	
	PeriphClkInitStruct.PeriphClockSelection = RCC_PERIPHCLK_I2S;

	//get 1MHz from 16MHz HSI
	//PeriphClkInitStruct.PLLI2S.PLLI2SM = 16;
	
	// from reference manual for 44.1kHz (no MCLK)
	PeriphClkInitStruct.PLLI2S.PLLI2SR = 2;
	PeriphClkInitStruct.PLLI2S.PLLI2SN = 302;
	
    HAL_RCCEx_PeriphCLKConfig(&PeriphClkInitStruct);
	
	// set up I2S
	
    hi2s2.Instance = SPI3;
    hi2s2.Init.Mode = I2S_MODE_MASTER_TX;
    hi2s2.Init.Standard = I2S_STANDARD_PHILLIPS;
    hi2s2.Init.DataFormat = I2S_DATAFORMAT_16B;
    hi2s2.Init.MCLKOutput = I2S_MCLKOUTPUT_DISABLE;
    hi2s2.Init.AudioFreq = I2S_AUDIOFREQ_44K;
    hi2s2.Init.CPOL = I2S_CPOL_LOW;
    hi2s2.Init.ClockSource = I2S_CLOCK_PLL;
    //hi2s2.Init.FullDuplexMode = I2S_FULLDUPLEXMODE_DISABLE;  

    if (HAL_I2S_Init(&hi2s2) != HAL_OK) {
        printf("wop\n");
    }

    uint16_t test = 0x00;

    int index = 0;

    bool channel = false;
    
    while (1)
    {

        if (HAL_I2S_GetState(&hi2s2) == HAL_I2S_STATE_READY)
        {

            HAL_I2S_Transmit(&hi2s2, &SINE_TABLE[index], 1, 0);

            channel = !channel;
            if (channel)
            {
                index++;
                index = index % 256;
            }
        }
    }
}